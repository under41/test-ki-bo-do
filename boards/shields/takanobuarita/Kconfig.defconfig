## boards/shields/takanobuarita/Kconfig.defconfig
```kconfig
if SHIELD_TAKANOBUARITA_RIGHT

config ZMK_KEYBOARD_NAME
    default "takanobuarita"

endif

if SHIELD_TAKANOBUARITA_LEFT || SHIELD_TAKANOBUARITA_RIGHT

config ZMK_SPLIT
    default y

endif
```

## boards/shields/takanobuarita/Kconfig.shield
```kconfig
config SHIELD_TAKANOBUARITA_LEFT
    def_bool $(shields_list_contains,takanobuarita_left)
config SHIELD_TAKANOBUARITA_RIGHT
    def_bool $(shields_list_contains,takanobuarita_right)
```
